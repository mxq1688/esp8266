## esp-idf/sdkconfig.defaults
```kconfig
CONFIG_ESP8266_DEFAULT_CPU_FREQ_80=y
CONFIG_ESP8266_DEFAULT_CPU_FREQ_160=n
CONFIG_ESP8266_DEFAULT_CPU_FREQ_240=n
CONFIG_ESP8266_DEFAULT_CPU_FREQ_MHZ=80

CONFIG_ESPTOOLPY_FLASHMODE_QIO=y
CONFIG_ESPTOOLPY_FLASHMODE_QOUT=n
CONFIG_ESPTOOLPY_FLASHMODE_DIO=n
CONFIG_ESPTOOLPY_FLASHMODE_DOUT=n
CONFIG_ESPTOOLPY_FLASHMODE="qio"

CONFIG_ESPTOOLPY_FLASHFREQ_40M=y
CONFIG_ESPTOOLPY_FLASHFREQ_80M=n
CONFIG_ESPTOOLPY_FLASHFREQ_20M=n
CONFIG_ESPTOOLPY_FLASHFREQ_26M=n
CONFIG_ESPTOOLPY_FLASHFREQ_80M_DIV2=n
CONFIG_ESPTOOLPY_FLASHFREQ="40m"

CONFIG_ESPTOOLPY_FLASHSIZE_4MB=y
CONFIG_ESPTOOLPY_FLASHSIZE_2MB=n
CONFIG_ESPTOOLPY_FLASHSIZE_8MB=n
CONFIG_ESPTOOLPY_FLASHSIZE_16MB=n
CONFIG_ESPTOOLPY_FLASHSIZE="4MB"

CONFIG_ESPTOOLPY_FLASHSIZE_DETECT=y

CONFIG_ESPTOOLPY_BEFORE_RESET=y
CONFIG_ESPTOOLPY_BEFORE_NORESET=n
CONFIG_ESPTOOLPY_BEFORE="default_reset"

CONFIG_ESPTOOLPY_AFTER_RESET=y
CONFIG_ESPTOOLPY_AFTER_NORESET=n
CONFIG_ESPTOOLPY_AFTER="hard_reset"

CONFIG_ESPTOOLPY_MONITOR_BAUD_115200B=y
CONFIG_ESPTOOLPY_MONITOR_BAUD_230400B=n
CONFIG_ESPTOOLPY_MONITOR_BAUD_921600B=n
CONFIG_ESPTOOLPY_MONITOR_BAUD_2MB=n
CONFIG_ESPTOOLPY_MONITOR_BAUD_OTHER=n
CONFIG_ESPTOOLPY_MONITOR_BAUD_OTHER_VAL=115200
CONFIG_ESPTOOLPY_MONITOR_BAUD=115200
```
